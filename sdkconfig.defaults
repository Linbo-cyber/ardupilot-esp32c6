## sdkconfig.defaults
```kconfig
# ESP32-C6 ArduPilot Rover
CONFIG_IDF_TARGET="esp32c6"
CONFIG_FREERTOS_HZ=1000
CONFIG_FREERTOS_UNICORE=y
CONFIG_ESP_DEFAULT_CPU_FREQ_MHZ_160=y

# USB CDC
CONFIG_TINYUSB_CDC_ENABLED=y

# WiFi
CONFIG_ESP_WIFI_ENABLED=y

# ADC
CONFIG_ADC_DISABLE_DAC=y

# Optimization
CONFIG_COMPILER_OPTIMIZATION_PERF=y
CONFIG_FREERTOS_PLACE_FUNCTIONS_INTO_FLASH=y

# Stack sizes
CONFIG_ESP_MAIN_TASK_STACK_SIZE=8192
CONFIG_FREERTOS_TIMER_TASK_STACK_DEPTH=4096

# Partition table
CONFIG_PARTITION_TABLE_CUSTOM=y
CONFIG_PARTITION_TABLE_CUSTOM_FILENAME="partitions.csv"
```
